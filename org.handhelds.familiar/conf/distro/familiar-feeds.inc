## org.handhelds.familiar/conf/distro/familiar-feeds.inc
```bitbake
DISTRO_FEEDS_PREFIX = "http://familiar.handhelds.org/releases/${DISTRO_VERSION}"

DISTRO_FEEDS_COLLECTIONS = "feed universe"
DISTRO_FEEDS_COLLECTION_DESC_feed = "Familiar ${DISTRO_VERSION} feeds"
DISTRO_FEEDS_COLLECTION_DESC_universe = "Familiar ${DISTRO_VERSION} universe feeds"

# opie and gpe images append to this
DISTRO_FEEDS_IN_feed = "base updates common"
DISTRO_FEEDS_IN_universe = "common"

DISTRO_FEEDS_FEED_DESC_base = "essential packages"
DISTRO_FEEDS_FEED_DESC_updates = "security updates"
DISTRO_FEEDS_FEED_DESC_common = "additional packages not specific to any graphical environment"
DISTRO_FEEDS_FEED_DESC_x11 = "additional packages specific to the x11 graphical environment"
DISTRO_FEEDS_FEED_DESC_opie = "additional packages specific to the opie graphical environment"
```

## org.handhelds.familiar/conf/distro/familiar.conf
```bitbake
#@TYPE: Distribution
#@NAME: Familiar Linux
#@DESCRIPTION: Distribution configuration for Familiar Linux (handhelds.org)

DEFAULT_MAINTAINER = "Familiar Developers <familiar-dev@handhelds.org>"
MAINTAINER := "${DEFAULT_MAINTAINER}"

INHERIT += "package_ipk debian"
TARGET_OS = "linux"

BOOTSTRAP_EXTRA_DEPENDS += "familiar-version"
BOOTSTRAP_EXTRA_RDEPENDS += "libgcc1 familiar-version"
IMAGE_NAME = "${IMAGE_BASENAME}-${DISTRO_VERSION}-${MACHINE}"
IMAGE_FSTYPES ?= "jffs2 tar"

ENABLE_BINARY_LOCALE_GENERATION ?= "1"
PARALLEL_INSTALL_MODULES = "1"
UDEV_DEVFS_RULES = "1"

# toolchain preferences
PREFERRED_PROVIDERS += " virtual/${TARGET_PREFIX}gcc-initial:gcc-cross-initial"
PREFERRED_PROVIDERS += " virtual/${TARGET_PREFIX}gcc:gcc-cross"
PREFERRED_PROVIDERS += " virtual/${TARGET_PREFIX}g++:gcc-cross"

# be more verbose by default
BBINCLUDELOGS ?= "yes"

include classes/multimachine.inc


# this file isn't supposed to be used directly
DISTRO_CHECK := "${@bb.data.getVar("DISTRO_VERSION",d,1) or bb.fatal('Remove this line or set a dummy DISTRO_VERSION if you really want to build an unversioned distro')}"
```

## org.handhelds.familiar/conf/machine/h4000.conf
```bitbake
#@TYPE: Machine
#@NAME: HP iPAQ h4xxx
#@DESCRIPTION: Machine configuration for the HP iPAQ h4xxx


TARGET_ARCH = "arm"
IPKG_ARCHS = "all arm armv4 armv4t armv5e armv5te ipaqpxa h4000"

PREFERRED_PROVIDER_xserver = "xserver-kdrive"
PREFERRED_PROVIDER_virtual/kernel = "handhelds-pxa-2.6"
PREFERRED_VERSION_handhelds-pxa-2.6 = "2.6.16-hh3"

#EXTRA_IMAGECMD_jffs2_h2200 = "--pad --no-cleanmarkers --eraseblock=16384"

ROOT_FLASH_SIZE = "32"

BOOTSTRAP_EXTRA_DEPENDS_append = " mtd-utils virtual/kernel udev module-init-tools"

BOOTSTRAP_EXTRA_RRECOMMENDS = " ${@linux_module_packages('${H4000_MODULES}', d)}"
BOOTSTRAP_EXTRA_RDEPENDS_append = " mtd-utils kernel udev module-init-tools"

#ship in rootfs:
H4000_MODULES = "g_ether g_serial g_file_storage snd-pcm-oss"

#autoload on boot:
module_autoload_snd-pcm-oss = "snd-pcm-oss"
module_autoload_g_ether = "g_ether"

SERIAL_CONSOLE = "115200 tts/0 vt100"

USE_VT = "0"

include conf/machine/ipaq-common.conf
include conf/machine/handheld-common.conf

GUI_MACHINE_CLASS = "smallscreen"
GPE_EXTRA_DEPENDS += "gaim gpe-filemanager"
GPE_EXTRA_INSTALL += "gaim gpe-filemanager"

include conf/machine/tune-strongarm.conf

# LAB can only resolve relative symlinks
ROOTFS_POSTPROCESS_COMMAND += "make_zimage_symlink_relative; "
```

## org.handhelds.familiar/conf/machine/ipaq-pxa270.conf
```bitbake
#@TYPE: Machine
#@NAME: iPAQ hx47xx hx2xxx
#@DESCRIPTION: Machine configuration for the iPAQ with a pxa27x CPU  devices

TARGET_ARCH = "arm"
IPKG_ARCHS = "all arm armv4 armv5te ipaqpxa hx4700"
PREFERRED_PROVIDER_virtual/kernel = "handhelds-pxa-2.6"
PREFERRED_VERSION_handhelds-pxa-2.6 = "2.6.15-hh2"

PREFERRED_VERSION_orinoco-modules = "0.15rc1"

BOOTSTRAP_EXTRA_DEPENDS = "ipaq-boot-params"
BOOTSTRAP_EXTRA_DEPENDS_append = " handhelds-pxa-2.6 udev module-init-tools"

ROOT_FLASH_SIZE = "80"

EXTRA_IMAGECMD_jffs2 = "; sumtool -i ${DEPLOY_DIR_IMAGE}/${IMAGE_NAME}.rootfs.jffs2 \
                        -o ${DEPLOY_DIR_IMAGE}/${IMAGE_NAME}.rootfs-summary.jffs2 \
                        -e 256KiB -p"

BOOTSTRAP_EXTRA_RDEPENDS = "kernel ipaq-boot-params ${@linux_module_packages('${PXA270_MODULES}', d)}"
BOOTSTRAP_EXTRA_RDEPENDS_append = " udev module-init-tools"

PXA270_MODULES = "g_ether g_file_storage g_serial \
		  snd_pcm_oss snd_mixer_oss acx \
		  nls_cp437 nls_iso8859-1 nls_utf8"

USE_VT = "0"

SERIAL_CONSOLE = "115200 ttyS0"

include conf/machine/ipaq-common.conf
include conf/machine/handheld-common.conf

GUI_MACHINE_CLASS = "bigscreen"
GPE_EXTRA_DEPENDS += "gaim gpe-filemanager" 
GPE_EXTRA_INSTALL += "gaim gpe-filemanager"

# Use tune-strongarm per default. Machine independent feeds should be built with tune-strongarm.
include conf/machine/tune-strongarm.conf

BOOTSTRAP_EXTRA_RDEPENDS += "${@linux_module_packages('${HX4700_MODULES}', d)}"
HX4700_MODULES = "hx4700_bt snd_hx4700_audio hx4700_acx"

# bt can take a command-line no-led option
module_autoload_hx4700_bt = "hx4700_bt"
module_autoload_hx4700_acx = "hx4700_acx"
module_autoload_acx = "acx"
module_autoload_snd-hx4700_audio = "snd-hx4700_audio"
module_autoload_snd-pcm-oss = "snd-pcm-oss"
module_autoload_snd-mixer-oss = "snd-mixer-oss"

#FIXME: this should be controlled by a userspace utility later.
module_autoload_g_ether = "g_ether"
```
